## main/Kconfig.projbuild
```kconfig
menu "ESP-SDR transport"

    config ESP_SDR_UART_ENABLED
        bool "Burst UART0 I/Q transport" if !IDF_TARGET_ESP32 && !IDF_TARGET_ESP32C2
        depends on IDF_TARGET_ESP32H2 || IDF_TARGET_ESP32C2 || IDF_TARGET_ESP32C5 || IDF_TARGET_ESP32C3 || IDF_TARGET_ESP32 || IDF_TARGET_ESP32S2 || IDF_TARGET_ESP32S3 || IDF_TARGET_ESP32C61 || IDF_TARGET_ESP32C6 || IDF_TARGET_ESP32S31
        default y
        help
            Enable the optional USB-to-UART bridge interface. Disable it to
            leave the UART GPIOs unused by the application. Native USB remains
            available on chips that support it. The original ESP32 and ESP32-C2 require UART.

    config ESP_SDR_UART_BAUD
        int "Burst UART0 I/Q baud rate"
        depends on IDF_TARGET_ESP32H2 || IDF_TARGET_ESP32C2 || IDF_TARGET_ESP32C5 || IDF_TARGET_ESP32C3 || IDF_TARGET_ESP32 || IDF_TARGET_ESP32S2 || IDF_TARGET_ESP32S3 || IDF_TARGET_ESP32C61 || IDF_TARGET_ESP32C6 || IDF_TARGET_ESP32S31
        range 115200 2500000 if IDF_TARGET_ESP32C2
        range 115200 3000000 if !IDF_TARGET_ESP32C2
        default 2000000
        help
            The burst I/Q protocol is also available on UART0, 8N1, without
            hardware flow control. The browser baud rate must match this value.
            BAUD 1000000 and BAUD 2000000 can change the running UART rate.
            Resetting the board restores this configured default.

    config ESP_SDR_UART_TX_PIN
        int "Burst UART0 TX GPIO"
        depends on IDF_TARGET_ESP32H2 || IDF_TARGET_ESP32C2 || IDF_TARGET_ESP32C5 || IDF_TARGET_ESP32C3 || IDF_TARGET_ESP32 || IDF_TARGET_ESP32S2 || IDF_TARGET_ESP32S3 || IDF_TARGET_ESP32C61 || IDF_TARGET_ESP32C6 || IDF_TARGET_ESP32S31
        range 0 20 if IDF_TARGET_ESP32C2
        range 0 27 if IDF_TARGET_ESP32H2
        range 0 48 if !IDF_TARGET_ESP32S31 && !IDF_TARGET_ESP32C2 && !IDF_TARGET_ESP32H2
        range 0 63 if IDF_TARGET_ESP32S31
        default 1 if IDF_TARGET_ESP32
        default 24 if IDF_TARGET_ESP32H2
        default 20 if IDF_TARGET_ESP32C2
        default 21 if IDF_TARGET_ESP32C3
        default 58 if IDF_TARGET_ESP32S31
        default 16 if IDF_TARGET_ESP32C6
        default 11 if IDF_TARGET_ESP32C61 || IDF_TARGET_ESP32C5
        default 43

    config ESP_SDR_UART_RX_PIN
        int "Burst UART0 RX GPIO"
        depends on IDF_TARGET_ESP32H2 || IDF_TARGET_ESP32C2 || IDF_TARGET_ESP32C5 || IDF_TARGET_ESP32C3 || IDF_TARGET_ESP32 || IDF_TARGET_ESP32S2 || IDF_TARGET_ESP32S3 || IDF_TARGET_ESP32C61 || IDF_TARGET_ESP32C6 || IDF_TARGET_ESP32S31
        range 0 20 if IDF_TARGET_ESP32C2
        range 0 27 if IDF_TARGET_ESP32H2
        range 0 48 if !IDF_TARGET_ESP32S31 && !IDF_TARGET_ESP32C2 && !IDF_TARGET_ESP32H2
        range 0 63 if IDF_TARGET_ESP32S31
        default 3 if IDF_TARGET_ESP32
        default 23 if IDF_TARGET_ESP32H2
        default 19 if IDF_TARGET_ESP32C2
        default 20 if IDF_TARGET_ESP32C3
        default 59 if IDF_TARGET_ESP32S31
        default 17 if IDF_TARGET_ESP32C6
        default 10 if IDF_TARGET_ESP32C61
        default 12 if IDF_TARGET_ESP32C5
        default 44

endmenu

menu "ESP-SDR LCD view"

    config ESP_SDR_LCD_VIEW
        bool "Standalone LCD spectrum view"
        depends on IDF_TARGET_ESP32S3
        default n
        help
            Draw a spectrum and waterfall on the board's 320x240 display
            while no host owns the serial link. The view runs short SPEC
            captures and draws between them, so it does not analyze every
            sample. Any host command stops the view until the serial lease
            expires. The board's LCD and input GPIOs are excluded from GPIO
            control.

    choice ESP_SDR_LCD_BOARD
        prompt "LCD view board"
        depends on ESP_SDR_LCD_VIEW
        default ESP_SDR_LCD_BOARD_BOXLITE

        config ESP_SDR_LCD_BOARD_BOXLITE
            bool "ESP32-S3-BOX-Lite"
            help
                ST7789 display. The middle button selects CENTER, SPAN, STEP
                or GAIN; the left and right buttons lower and raise it.

        config ESP_SDR_LCD_BOARD_CORES3
            bool "M5Stack CoreS3"
            help
                ILI9342C/E display behind the AXP2101 and AW9523, FT6336
                touch. Tapping a mode box selects it; elsewhere the left
                third lowers, the middle third cycles and the right third
                raises the setting.

    endchoice

endmenu
```
